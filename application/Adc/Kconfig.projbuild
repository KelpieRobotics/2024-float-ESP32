## application/Adc/Kconfig.projbuild
```kconfig
menu "ADC Attenuation Configuration"

    orsource "$IDF_PATH/examples/common_components/env_caps/$IDF_TARGET/Kconfig.env_caps"

    config ADC_ATTEN
        int "ADC Attenuation"
        range 0 3
        default 3
        help
            Specify ADC attenuation, 0 no attn, 1=2.5 dB, 2 = 6 dB, 3 = 12dB
            

endmenu
```

## application/Tcp/Kconfig.projbuild
```kconfig
menu "TCP Configuration"

    orsource "$IDF_PATH/examples/common_components/env_caps/$IDF_TARGET/Kconfig.env_caps"

    config HOST_IP_ADDR
        string  "Host IP"
        default "192.168.2.10"
        help
            Host IP address.

    config PORT
        int "Port number"
        default 3333
        help 
            Port number

endmenu
```

## application/Wifi/Kconfig.projbuild
```kconfig
menu "WiFi Configuration"

    orsource "$IDF_PATH/examples/common_components/env_caps/$IDF_TARGET/Kconfig.env_caps"

    config WIFI_SSID
        string  "SSID of WiFi network"
        default ""
        help
            SSID of WiFi network.

    config WIFI_PASS
        string "Password for WiFi network"
        default ""
        help
            Password for WiFi network.

    config WIFI_RETRY_COUNT
        int "Number of attempts to reconnect to wifi"
        default 3
        help
            Number of attempts to reconnect to wifi
endmenu
```

## core/Kconfig.projbuild
```kconfig
menu "Hbidge Configuration"

    orsource "$IDF_PATH/examples/common_components/env_caps/$IDF_TARGET/Kconfig.env_caps"

    config HBRIDGE_PIN_1
        int "Hbridge output pin 1"
        range ENV_GPIO_RANGE_MIN ENV_GPIO_OUT_RANGE_MAX
        default 32
        help
            GPIO number to be used as Hbridge pin 1. See board docs for GPIO number to physical pin mapping.

    config HBRIDGE_PIN_2
        int "Hbridge output pin 2"
        range ENV_GPIO_RANGE_MIN ENV_GPIO_OUT_RANGE_MAX
        default 33
        help
            GPIO number to be used as Hbridge pin 1. See board docs for GPIO number to physical pin mapping.

endmenu

menu "ADC Configuration"

    orsource "$IDF_PATH/examples/common_components/env_caps/$IDF_TARGET/Kconfig.env_caps"

    config ADC_UNIT
        int "ADC unit"
        range 0 1
        default 0
        help
            Selects which ADC unit to use, 0 = ADC1, 1 = ADC2. ADC2 is used by wifi driver so 1 is reccomended.

    config LEAK_SENS_PIN
        int "Leak sensor channel"
        range 0 9
        default 0
        help
            ADC channel for leak sensor. See board docs for channel to physical pin mapping.

    config PRESSURE_SENS_PIN
        int "Pressure sensor channel"
        range 0 9
        default 1
        help
            ADC channel for pressure sensor. See board docs for channel to physical pin mapping.

endmenu
```
